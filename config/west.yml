## config/west.yml
```yaml
manifest:
  remotes:
    - name: zmkfirmware
      url-base: https://github.com/slowkoi
  projects:
    - name: zmk
      remote: zmkfirmware
      revision: feature-test
      import: app/west.yml
  self:
    path: config
```
